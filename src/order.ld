/* Generated by `just order` from test/order: the functions lua calls
   first, in that order, ahead of the rest of its code. Regenerate it
   when startup changes; a stale line costs memory, not correctness. */
SECTIONS {
  .plt : { *(.plt) }
  .text.hot : {
    *crt1.o(.text .text.*)
    *(.text.start._start .text.unlikely.start._start)
    *(.text.start.posixCallMainAndExit .text.unlikely.start.posixCallMainAndExit)
    *(.text.compiler_rt.memset .text.unlikely.compiler_rt.memset)
    *(.text.compiler_rt.memcpy.memcpyFast .text.unlikely.compiler_rt.memcpy.memcpyFast)
    *(.text.main.main .text.unlikely.main.main)
    *(.text.Thread.getCpuCount .text.unlikely.Thread.getCpuCount)
    *(.text.compiler_rt.strlen .text.unlikely.compiler_rt.strlen)
    *(.text.heap.SmpAllocator.alloc .text.unlikely.heap.SmpAllocator.alloc)
    *(.text.heap.SmpAllocator.getCpuCount .text.unlikely.heap.SmpAllocator.getCpuCount)
    *(.text.heap.PageAllocator.map .text.unlikely.heap.PageAllocator.map)
    *(.text.mem.eql__anon_* .text.unlikely.mem.eql__anon_*)
    *(.text.hash.wyhash.Wyhash.hash .text.unlikely.hash.wyhash.Wyhash.hash)
    *(.text.heap.SmpAllocator.free .text.unlikely.heap.SmpAllocator.free)
    *(.text.heap.ArenaAllocator.alloc .text.unlikely.heap.ArenaAllocator.alloc)
    *(.text.heap.PageAllocator.alloc .text.unlikely.heap.PageAllocator.alloc)
    *(.text.State.create .text.unlikely.State.create)
    *(.text.String.Interner.create .text.unlikely.String.Interner.create)
    *(.text.gc.Heap.Counting??strings??0..7??.alloc .text.unlikely.gc.Heap.Counting??strings??0..7??.alloc)
    *(.text.SmallAllocator.alloc .text.unlikely.SmallAllocator.alloc)
    *(.text.Thread.create .text.unlikely.Thread.create)
    *(.text.Table.resize .text.unlikely.Table.resize)
    *(.text.Table.setShortStr .text.unlikely.Table.setShortStr)
    *(.text.Table.newKey .text.unlikely.Table.newKey)
    *(.text.Table.insert .text.unlikely.Table.insert)
    *(.text.Table.set .text.unlikely.Table.set)
    *(.text.lib.package.registryTable .text.unlikely.lib.package.registryTable)
    *(.text.lib.base.open .text.unlikely.lib.base.open)
    *(.text.lib.package.open .text.unlikely.lib.package.open)
    *(.text.lib.auxlib.newLibFrom .text.unlikely.lib.auxlib.newLibFrom)
    *(.text.array_hash_map.Custom???const?u8???const?u8?process.Environ.Map.EnvNameHashContext?false?.getIndexAdapted__anon_* .text.unlikely.array_hash_map.Custom???const?u8???const?u8?process.Environ.Map.EnvNameHashContext?false?.getIndexAdapted__anon_*)
    *(.text.lib.auxlib.Buffer.drain .text.unlikely.lib.auxlib.Buffer.drain)
    *(.text.lib.auxlib.Buffer.ensureUnused .text.unlikely.lib.auxlib.Buffer.ensureUnused)
    *(.text.lib.init.onState__struct_*.f .text.unlikely.lib.init.onState__struct_34913.f .text.unlikely.lib.init.onState__struct_34929.f .text.unlikely.lib.init.onState__struct_34953.f .text.unlikely.lib.init.onState__struct_34976.f .text.unlikely.lib.init.onState__struct_34989.f .text.unlikely.lib.init.onState__struct_35003.f .text.unlikely.lib.init.onState__struct_34469.f .text.unlikely.lib.init.onState__struct_34485.f .text.unlikely.lib.init.onState__struct_34509.f .text.unlikely.lib.init.onState__struct_34532.f .text.unlikely.lib.init.onState__struct_34545.f .text.unlikely.lib.init.onState__struct_34559.f .text.unlikely.lib.init.onState__struct_35475.f .text.unlikely.lib.init.onState__struct_35491.f .text.unlikely.lib.init.onState__struct_35515.f .text.unlikely.lib.init.onState__struct_35538.f .text.unlikely.lib.init.onState__struct_35551.f .text.unlikely.lib.init.onState__struct_35565.f)
    *(.text.lib.io.open .text.unlikely.lib.io.open)
    *(.text.Io.Threaded.fileIsTty .text.unlikely.Io.Threaded.fileIsTty)
    *(.text.lib.io.newHandle .text.unlikely.lib.io.newHandle)
    *(.text.State.setMetatable .text.unlikely.State.setMetatable)
    *(.text.String.Interner.resize .text.unlikely.String.Interner.resize)
    *(.text.lib.math.Rng.seed .text.unlikely.lib.math.Rng.seed)
    *(.text.lib.os.open .text.unlikely.lib.os.open)
    *(.text.gc.changeMode .text.unlikely.gc.changeMode)
    *(.text.gc.singleStep .text.unlikely.gc.singleStep)
    *(.text.gc.reallyMarkObject .text.unlikely.gc.reallyMarkObject)
    *(.text.gc.objSize .text.unlikely.gc.objSize)
    *(.text.gc.markMetatables .text.unlikely.gc.markMetatables)
    *(.text.gc.atomic .text.unlikely.gc.atomic)
    *(.text.gc.propagateMark .text.unlikely.gc.propagateMark)
    *(.text.gc.clearByValues .text.unlikely.gc.clearByValues)
    *(.text.gc.atomic2gen .text.unlikely.gc.atomic2gen)
    *(.text.gc.sweep2old .text.unlikely.gc.sweep2old)
    *(.text.gc.correctGrayLists .text.unlikely.gc.correctGrayLists)
    *(.text.api.State.call__anon_* .text.unlikely.api.State.call__anon_*)
    *(.text.vm.callYieldable .text.unlikely.vm.callYieldable)
    *(.text.vm.preCall .text.unlikely.vm.preCall)
    *(.text.vm.callNative .text.unlikely.vm.callNative)
    *(.text.api.Native??function??pmain????main.Interp?.call .text.unlikely.api.Native??function??pmain????main.Interp?.call)
    *(.text.Table.setIntHash .text.unlikely.Table.setIntHash)
    *(.text.gc.barrierBackSlow .text.unlikely.gc.barrierBackSlow)
    *(.text.api.State.load .text.unlikely.api.State.load)
    *(.text.lib.base.loadChunk .text.unlikely.lib.base.loadChunk)
    *(.text.mem.findScalarPos__anon_* .text.unlikely.mem.findScalarPos__anon_*)
    *(.text.array_list.Aligned?u32?null?.append .text.unlikely.array_list.Aligned?u32?null?.append)
    *(.text.gc.Heap.Counting??backing??0..7??.alloc .text.unlikely.gc.Heap.Counting??backing??0..7??.alloc)
    *(.text.Code.FuncState.saveLineInfo .text.unlikely.Code.FuncState.saveLineInfo)
    *(.text.Parser.allocUpvalue .text.unlikely.Parser.allocUpvalue)
    *(.text.Parser.scan .text.unlikely.Parser.scan)
    *(.text.Parser.closeFunc .text.unlikely.Parser.closeFunc)
    *(.text.Parser.leaveBlock .text.unlikely.Parser.leaveBlock)
    *(.text.gc.Heap.Counting??backing??0..7??.remap .text.unlikely.gc.Heap.Counting??backing??0..7??.remap)
    *(.text.heap.SmpAllocator.remap .text.unlikely.heap.SmpAllocator.remap)
    *(.text.gc.Heap.Counting??backing??0..7??.free .text.unlikely.gc.Heap.Counting??backing??0..7??.free)
    *(.text.Code.FuncState.deinit .text.unlikely.Code.FuncState.deinit)
    *(.text.Parser.deinit .text.unlikely.Parser.deinit)
    *(.text.main.Interp.docall .text.unlikely.main.Interp.docall)
    *(.text.vm.runLoop__anon_* .text.unlikely.vm.runLoop__anon_19024 .text.unlikely.vm.runLoop__anon_7132 .text.unlikely.vm.runLoop__anon_19667)
    *(.text.vm.adjustVarargs .text.unlikely.vm.adjustVarargs)
    *(.text.vm.closeState .text.unlikely.vm.closeState)
    *(.text.vm.closeProtected .text.unlikely.vm.closeProtected)
    *(.text.vm.closeLevel__anon_* .text.unlikely.vm.closeLevel__anon_25782 .text.unlikely.vm.closeLevel__anon_25357 .text.unlikely.vm.closeLevel__anon_26559 .text.unlikely.vm.closeLevel__anon_21438 .text.unlikely.vm.closeLevel__anon_9545 .text.unlikely.vm.closeLevel__anon_22080)
    *(.text.gc.minor2inc .text.unlikely.gc.minor2inc)
    *(.text.gc.callFinalizer .text.unlikely.gc.callFinalizer)
    *(.text.lib.io.fGc .text.unlikely.lib.io.fGc)
    *(.text.lib.io.testStream .text.unlikely.lib.io.testStream)
    *(.text.lib.io.closeStream .text.unlikely.lib.io.closeStream)
    *(.text.lib.io.flushAll .text.unlikely.lib.io.flushAll)
    *(.text.Io.Writer.defaultFlush .text.unlikely.Io.Writer.defaultFlush)
    *(.text.State.destroy .text.unlikely.State.destroy)
    *(.text.gc.freeAll .text.unlikely.gc.freeAll)
    *(.text.gc.destroyObject .text.unlikely.gc.destroyObject)
    *(.text.gc.Heap.Counting??strings??0..7??.free .text.unlikely.gc.Heap.Counting??strings??0..7??.free)
    *(.text.SmallAllocator.free .text.unlikely.SmallAllocator.free)
    *(.text.process.Environ.Map.deinit .text.unlikely.process.Environ.Map.deinit)
    *(.text.Io.Threaded.deinit .text.unlikely.Io.Threaded.deinit)
    *(.text.heap.PageAllocator.free .text.unlikely.heap.PageAllocator.free)
    *(.text._start .text.unlikely._start .text.compiler_rt._start)
    *(.text.start.main .text.unlikely.start.main)
    *(.text.capi.liolib.open .text.unlikely.capi.liolib.open)
    *(.text.capi.capi.lightCFunction .text.unlikely.capi.capi.lightCFunction)
    *(.text.Table.findNode .text.unlikely.Table.findNode)
    *(.text.Table.get .text.unlikely.Table.get)
    *(.text.capi.capi.trampoline .text.unlikely.capi.capi.trampoline)
    *(.text.capi.jmp.callNaked .text.unlikely.capi.jmp.callNaked)
    *(.text.capi.liolib.luaopenIo .text.unlikely.capi.liolib.luaopenIo)
    *(.text.capi.capi.luaCreatetable .text.unlikely.capi.capi.luaCreatetable)
    *(.text.capi.lauxlib.lauxSetfuncs .text.unlikely.capi.lauxlib.lauxSetfuncs)
    *(.text.capi.lauxlib.lauxCheckstack .text.unlikely.capi.lauxlib.lauxCheckstack)
    *(.text.capi.capi.luaPushcclosure .text.unlikely.capi.capi.luaPushcclosure)
    *(.text.capi.capi.luaSetfield .text.unlikely.capi.capi.luaSetfield)
    *(.text.vm.setSlow__anon_* .text.unlikely.vm.setSlow__anon_33157)
    *(.text.capi.lauxlib.lauxNewmetatable .text.unlikely.capi.lauxlib.lauxNewmetatable)
    *(.text.capi.capi.luaGetfield .text.unlikely.capi.capi.luaGetfield)
    *(.text.capi.liolib.newPrefile .text.unlikely.capi.liolib.newPrefile)
    *(.text.capi.liolib.fGc .text.unlikely.capi.liolib.fGc)
    *(.text.capi.lauxlib.lauxTestudata .text.unlikely.capi.lauxlib.lauxTestudata)
    *(.text.capi.liolib.ioNoclose .text.unlikely.capi.liolib.ioNoclose)
    *(.text.capi.liolib.flushAll .text.unlikely.capi.liolib.flushAll)
    *(.text.Table.length .text.unlikely.Table.length)
    *(.text.heap.PageAllocator.unmap .text.unlikely.heap.PageAllocator.unmap)
    *(.text.heap.SmpAllocator.Thread.lock .text.unlikely.heap.SmpAllocator.Thread.lock)
    *(.text.posix.mmap .text.unlikely.posix.mmap)
    *(.text.array_hash_map.Custom???const?u8???const?u8?process.Environ.Map.EnvNameHashContext?false?.getOrPutInternal__anon_* .text.unlikely.array_hash_map.Custom???const?u8???const?u8?process.Environ.Map.EnvNameHashContext?false?.getOrPutInternal__anon_49879)
    *(.text.array_list.Aligned?Thread.Frame?null?.ensureTotalCapacity .text.unlikely.array_list.Aligned?Thread.Frame?null?.ensureTotalCapacity)
    *(.text.Table.create .text.unlikely.Table.create)
    *(.text.Table.mainPosition .text.unlikely.Table.mainPosition)
    *(.text.lib.package.closure .text.unlikely.lib.package.closure)
    *(.text.lib.os.getenv .text.unlikely.lib.os.getenv)
    *(.text.array_hash_map.Custom???const?u8???const?u8?process.Environ.Map.EnvNameHashContext?false?.getIndexWithHeaderGeneric__anon_* .text.unlikely.array_hash_map.Custom???const?u8???const?u8?process.Environ.Map.EnvNameHashContext?false?.getIndexWithHeaderGeneric__anon_34588)
    *(.text.array_hash_map.Custom???const?u8???const?u8?process.Environ.Map.EnvNameHashContext?false?.getSlotByKey__anon_* .text.unlikely.array_hash_map.Custom???const?u8???const?u8?process.Environ.Map.EnvNameHashContext?false?.getSlotByKey__anon_34690)
    *(.text.Io.Writer.writeAll .text.unlikely.Io.Writer.writeAll)
    *(.text.lib.auxlib.Buffer.toString .text.unlikely.lib.auxlib.Buffer.toString)
    *(.text.String.createLong .text.unlikely.String.createLong)
    *(.text.lib.io.fileMeta .text.unlikely.lib.io.fileMeta)
    *(.text.Io.Threaded.isTty .text.unlikely.Io.Threaded.isTty)
    *(.text.gc.separateToBeFinalized .text.unlikely.gc.separateToBeFinalized)
    *(.text.gc.setMinorDebt .text.unlikely.gc.setMinorDebt)
    *(.text.vm.pcallMsgh .text.unlikely.vm.pcallMsgh)
    *(.text.main.Interp.getenv .text.unlikely.main.Interp.getenv)
    *(.text.Code.FuncState.codeAbck .text.unlikely.Code.FuncState.codeAbck)
    *(.text.gc.sweepToLive .text.unlikely.gc.sweepToLive)
    *(.text.State.tmOf .text.unlikely.State.tmOf)
    *(.text.lib.io.checkStream .text.unlikely.lib.io.checkStream)
    *(.text.lib.io.Stream.flush .text.unlikely.lib.io.Stream.flush)
    *(.text.process.exit .text.unlikely.process.exit)
    *(.text.os.linux.exit_group .text.unlikely.os.linux.exit_group)
    *(.text.lib.base.loadFile .text.unlikely.lib.base.loadFile)
    *(.text.Io.Threaded.dirOpenFilePosix .text.unlikely.Io.Threaded.dirOpenFilePosix)
    *(.text.Io.Reader.appendRemainingAligned__anon_* .text.unlikely.Io.Reader.appendRemainingAligned__anon_*)
    *(.text.Io.File.Reader.stream .text.unlikely.Io.File.Reader.stream)
    *(.text.Io.Writer.Allocating.sendFile .text.unlikely.Io.Writer.Allocating.sendFile)
    *(.text.Io.Threaded.fileStatLinux .text.unlikely.Io.Threaded.fileStatLinux)
    *(.text.Io.Reader.readVec .text.unlikely.Io.Reader.readVec)
    *(.text.Io.File.Reader.readVec .text.unlikely.Io.File.Reader.readVec)
    *(.text.Io.File.Reader.readVecPositional .text.unlikely.Io.File.Reader.readVecPositional)
    *(.text.Io.Threaded.fileReadPositional .text.unlikely.Io.Threaded.fileReadPositional)
    *(.text.array_list.Aligned?u8?null?.toOwnedSliceSentinel__anon_* .text.unlikely.array_list.Aligned?u8?null?.toOwnedSliceSentinel__anon_*)
    *(.text.array_list.Aligned?u8?null?.toOwnedSlice .text.unlikely.array_list.Aligned?u8?null?.toOwnedSlice)
    *(.text.Io.Threaded.fileClose .text.unlikely.Io.Threaded.fileClose)
    *(.text.Lexer.newline .text.unlikely.Lexer.newline)
    *(.text.Parser.statement .text.unlikely.Parser.statement)
    *(.text.Parser.newString .text.unlikely.Parser.newString)
    *(.text.Parser.getVarAttribute .text.unlikely.Parser.getVarAttribute)
    *(.text.Parser.newVarKind .text.unlikely.Parser.newVarKind)
    *(.text.Parser.expList .text.unlikely.Parser.expList)
    *(.text.Parser.subExpr .text.unlikely.Parser.subExpr)
    *(.text.Parser.constructor .text.unlikely.Parser.constructor)
    *(.text.Parser.adjustAssign .text.unlikely.Parser.adjustAssign)
    *(.text.Code.FuncState.exp2nextreg .text.unlikely.Code.FuncState.exp2nextreg)
    *(.text.Code.FuncState.dischargeVars .text.unlikely.Code.FuncState.dischargeVars)
    *(.text.Code.FuncState.exp2reg .text.unlikely.Code.FuncState.exp2reg)
    *(.text.Code.FuncState.discharge2reg .text.unlikely.Code.FuncState.discharge2reg)
    *(.text.Parser.adjustLocalVars .text.unlikely.Parser.adjustLocalVars)
    *(.text.Lexer.numeral .text.unlikely.Lexer.numeral)
    *(.text.number.parse .text.unlikely.number.parse)
    *(.text.Code.FuncState.int .text.unlikely.Code.FuncState.int)
    *(.text.Parser.forBody .text.unlikely.Parser.forBody)
    *(.text.Parser.primaryExp .text.unlikely.Parser.primaryExp)
    *(.text.Parser.singleVar .text.unlikely.Parser.singleVar)
    *(.text.Parser.singleVarAux .text.unlikely.Parser.singleVarAux)
    *(.text.Parser.suffixes .text.unlikely.Parser.suffixes)
    *(.text.Code.FuncState.exp2anyregup .text.unlikely.Code.FuncState.exp2anyregup)
    *(.text.Code.FuncState.prefix .text.unlikely.Code.FuncState.prefix)
    *(.text.Code.FuncState.codeUnExpVal .text.unlikely.Code.FuncState.codeUnExpVal)
    *(.text.Code.FuncState.infix .text.unlikely.Code.FuncState.infix)
    *(.text.Code.FuncState.posfix .text.unlikely.Code.FuncState.posfix)
    *(.text.Code.constFolding .text.unlikely.Code.constFolding)
    *(.text.Code.FuncState.finishBinExpVal .text.unlikely.Code.FuncState.finishBinExpVal)
    *(.text.Code.FuncState.freeRegs .text.unlikely.Code.FuncState.freeRegs)
    *(.text.Code.FuncState.exp2val .text.unlikely.Code.FuncState.exp2val)
    *(.text.Code.FuncState.indexed .text.unlikely.Code.FuncState.indexed)
    *(.text.Parser.restAssign .text.unlikely.Parser.restAssign)
    *(.text.Parser.buildGlobal .text.unlikely.Parser.buildGlobal)
    *(.text.Code.FuncState.k2proto .text.unlikely.Code.FuncState.k2proto)
    *(.text.array_list.Aligned?Value?null?.ensureTotalCapacity .text.unlikely.array_list.Aligned?Value?null?.ensureTotalCapacity)
    *(.text.hash_map.HashMapUnmanaged?Code.KKey?u32?Code.KKey.Context?80?.grow .text.unlikely.hash_map.HashMapUnmanaged?Code.KKey?u32?Code.KKey.Context?80?.grow)
    *(.text.Parser.fieldSel .text.unlikely.Parser.fieldSel)
    *(.text.Parser.funcArgs .text.unlikely.Parser.funcArgs)
    *(.text.Code.FuncState.codeK .text.unlikely.Code.FuncState.codeK)
    *(.text.Code.FuncState.exp2K .text.unlikely.Code.FuncState.exp2K)
    *(.text.Code.FuncState.storeVar .text.unlikely.Code.FuncState.storeVar)
    *(.text.Code.FuncState.exp2Rk .text.unlikely.Code.FuncState.exp2Rk)
    *(.text.Code.FuncState.codeBinExpVal .text.unlikely.Code.FuncState.codeBinExpVal)
    *(.text.Parser.recField .text.unlikely.Parser.recField)
    *(.text.Parser.testThenBlock .text.unlikely.Parser.testThenBlock)
    *(.text.Code.FuncState.goIfTrue .text.unlikely.Code.FuncState.goIfTrue)
    *(.text.Code.FuncState.jumpOnCond .text.unlikely.Code.FuncState.jumpOnCond)
    *(.text.Code.FuncState.condJump .text.unlikely.Code.FuncState.condJump)
    *(.text.Parser.body .text.unlikely.Parser.body)
    *(.text.Code.FuncState.exp2anyreg .text.unlikely.Code.FuncState.exp2anyreg)
    *(.text.fmt.parse_float.parseFloat__anon_* .text.unlikely.fmt.parse_float.parseFloat__anon_*)
    *(.text.Code.FuncState.numberK .text.unlikely.Code.FuncState.numberK)
    *(.text.Value.rawEquals .text.unlikely.Value.rawEquals)
    *(.text.mem.swap__anon_* .text.unlikely.mem.swap__anon_*)
    *(.text.Code.FuncState.patchListAux .text.unlikely.Code.FuncState.patchListAux)
    *(.text.api.State.getGlobal__anon_* .text.unlikely.api.State.getGlobal__anon_*)
    *(.text.compiler_rt.memmove.memmoveFast .text.unlikely.compiler_rt.memmove.memmoveFast)
    *(.text.vm.forPrep .text.unlikely.vm.forPrep)
    *(.text.vm.getSlow__anon_* .text.unlikely.vm.getSlow__anon_21276 .text.unlikely.vm.getSlow__anon_9414 .text.unlikely.vm.getSlow__anon_21918)
    *(.text.lib.string.rep .text.unlikely.lib.string.rep)
    *(.text.lib.auxlib.Args.checkInteger .text.unlikely.lib.auxlib.Args.checkInteger)
    *(.text.lib.auxlib.Args.optString .text.unlikely.lib.auxlib.Args.optString)
    *(.text.lib.string.format .text.unlikely.lib.string.format)
    *(.text.lib.format.check .text.unlikely.lib.format.check)
    *(.text.lib.format.pad .text.unlikely.lib.format.pad)
    *(.text.gc.stepPaying .text.unlikely.gc.stepPaying)
    *(.text.gc.sweepGen .text.unlikely.gc.sweepGen)
    *(.text.lib.table.sort .text.unlikely.lib.table.sort)
    *(.text.lib.table.sortLength .text.unlikely.lib.table.sortLength)
    *(.text.lib.table.checkTab .text.unlikely.lib.table.checkTab)
    *(.text.lib.auxlib.lenInt .text.unlikely.lib.auxlib.lenInt)
    *(.text.lib.table.Sorter.sort .text.unlikely.lib.table.Sorter.sort)
    *(.text.lib.table.Sorter.geti .text.unlikely.lib.table.Sorter.geti)
    *(.text.lib.table.Sorter.less .text.unlikely.lib.table.Sorter.less)
    *(.text.vm.lessThan .text.unlikely.vm.lessThan)
    *(.text.vm.orderSlow__anon_* .text.unlikely.vm.orderSlow__anon_35422 .text.unlikely.vm.orderSlow__anon_35965 .text.unlikely.vm.orderSlow__anon_36968)
    *(.text.lib.table.Sorter.seti .text.unlikely.lib.table.Sorter.seti)
    *(.text.lib.table.concat .text.unlikely.lib.table.concat)
    *(.text.lib.table.addField .text.unlikely.lib.table.addField)
    *(.text.gc.Raw.realloc__anon_* .text.unlikely.gc.Raw.realloc__anon_*)
    *(.text.gc.Heap.Counting??strings??0..7??.remap .text.unlikely.gc.Heap.Counting??strings??0..7??.remap)
    *(.text.SmallAllocator.remap .text.unlikely.SmallAllocator.remap)
    *(.text.lib.string.gmatch .text.unlikely.lib.string.gmatch)
    *(.text.lib.string.gmatchAux .text.unlikely.lib.string.gmatchAux)
    *(.text.lib.pattern.Matcher.match .text.unlikely.lib.pattern.Matcher.match)
    *(.text.lib.pattern.Matcher.classEnd .text.unlikely.lib.pattern.Matcher.classEnd)
    *(.text.lib.pattern.Matcher.singleMatch .text.unlikely.lib.pattern.Matcher.singleMatch)
    *(.text.lib.string.pushCaptures .text.unlikely.lib.string.pushCaptures)
    *(.text.lib.pattern.Matcher.capture .text.unlikely.lib.pattern.Matcher.capture)
    *(.text.lib.base.tonumber .text.unlikely.lib.base.tonumber)
    *(.text.vm.setShortStrAt .text.unlikely.vm.setShortStrAt)
    *(.text.lib.base.pairs .text.unlikely.lib.base.pairs)
    *(.text.lib.base.getMetafield .text.unlikely.lib.base.getMetafield)
    *(.text.lib.base.next .text.unlikely.lib.base.next)
    *(.text.Table.next .text.unlikely.Table.next)
    *(.text.Thread.reallocStack .text.unlikely.Thread.reallocStack)
    *(.text.lib.base.tostring .text.unlikely.lib.base.tostring)
    *(.text.lib.auxlib.tolstring .text.unlikely.lib.auxlib.tolstring)
    *(.text.vm.numberToString .text.unlikely.vm.numberToString)
    *(.text.Io.Writer.alignBuffer .text.unlikely.Io.Writer.alignBuffer)
    *(.text.vm.concatValues__anon_* .text.unlikely.vm.concatValues__anon_21423 .text.unlikely.vm.concatValues__anon_9530 .text.unlikely.vm.concatValues__anon_22065)
    *(.text.lib.base.ipairs .text.unlikely.lib.base.ipairs)
    *(.text.lib.base.ipairsAux .text.unlikely.lib.base.ipairsAux)
    *(.text.lib.base.checkInteger .text.unlikely.lib.base.checkInteger)
    *(.text.lib.string.find .text.unlikely.lib.string.find)
    *(.text.mem.findPos__anon_* .text.unlikely.mem.findPos__anon_*)
    *(.text.lib.string.upper .text.unlikely.lib.string.upper)
    *(.text.lib.string.sub .text.unlikely.lib.string.sub)
    *(.text.lib.base.pcall .text.unlikely.lib.base.pcall)
    *(.text.vm.pcallk .text.unlikely.vm.pcallk)
    *(.text.lib.base.error .text.unlikely.lib.base.error)
    *(.text.vm.recover .text.unlikely.vm.recover)
    *(.text.lib.base.setmetatable .text.unlikely.lib.base.setmetatable)
    *(.text.lib.string.gsub .text.unlikely.lib.string.gsub)
    *(.text.lib.pattern.gsub__anon_* .text.unlikely.lib.pattern.gsub__anon_42148 .text.unlikely.lib.pattern.gsub__anon_42183 .text.unlikely.lib.pattern.gsub__anon_42911)
    *(.text.lib.base.type .text.unlikely.lib.base.type)
    *(.text.vm.finishOp .text.unlikely.vm.finishOp)
    *(.text.vm.getVarargs .text.unlikely.vm.getVarargs)
    *(.text.lib.base.select .text.unlikely.lib.base.select)
    *(.text.lib.math.floor .text.unlikely.lib.math.floor)
    *(.text.lib.auxlib.Args.checkNumber .text.unlikely.lib.auxlib.Args.checkNumber)
    *(.text.lib.math.max .text.unlikely.lib.math.max)
    *(.text.lib.os.time .text.unlikely.lib.os.time)
    *(.text.Io.Threaded.now .text.unlikely.Io.Threaded.now)
    *(.text.os.linux.init_vdso_clock_gettime .text.unlikely.os.linux.init_vdso_clock_gettime)
    *(.text.compiler_rt.udivmod.__divti3 .text.unlikely.compiler_rt.udivmod.__divti3)
    *(.text.compiler_rt.udivmod.udivmod__anon_* .text.unlikely.compiler_rt.udivmod.udivmod__anon_*)
    *(.text.lib.os.clock .text.unlikely.lib.os.clock)
    *(.text.compiler_rt.floattidf.__floattidf .text.unlikely.compiler_rt.floattidf.__floattidf)
    *(.text.number.formatFloat .text.unlikely.number.formatFloat)
    *(.text.fmt.float.binaryToDecimal__anon_* .text.unlikely.fmt.float.binaryToDecimal__anon_*)
    *(.text.number.layoutG .text.unlikely.number.layoutG)
    *(.text.lib.string.byte .text.unlikely.lib.string.byte)
    *(.text.lib.string.char .text.unlikely.lib.string.char)
    *(.text.lib.base.print .text.unlikely.lib.base.print)
    *(.text.Io.File.Writer.drain .text.unlikely.Io.File.Writer.drain)
    *(.text.Io.Threaded.operate .text.unlikely.Io.Threaded.operate)
    *(.text.Io.Threaded.fileWriteStreaming .text.unlikely.Io.Threaded.fileWriteStreaming)
    *(.text.api.State.unref .text.unlikely.api.State.unref)
    *(.text.compiler_rt.stack_probe.zig_probe_stack .text.unlikely.compiler_rt.stack_probe.zig_probe_stack)
    *(.text.Io.Threaded.pathToPosix .text.unlikely.Io.Threaded.pathToPosix)
    *(.text.Io.Reader.stream .text.unlikely.Io.Reader.stream)
    *(.text.Io.Writer.Allocating.ensureTotalCapacityPrecise .text.unlikely.Io.Writer.Allocating.ensureTotalCapacityPrecise)
    *(.text.Io.Reader.writableVector .text.unlikely.Io.Reader.writableVector)
    *(.text.Io.Writer.Allocating.toArrayListAligned__anon_* .text.unlikely.Io.Writer.Allocating.toArrayListAligned__anon_*)
    *(.text.array_list.Aligned?u8?null?.ensureTotalCapacityPrecise .text.unlikely.array_list.Aligned?u8?null?.ensureTotalCapacityPrecise)
    *(.text.Parser.endStatement .text.unlikely.Parser.endStatement)
    *(.text.Parser.enterBlock .text.unlikely.Parser.enterBlock)
    *(.text.Code.FuncState.codeAsBx .text.unlikely.Code.FuncState.codeAsBx)
    *(.text.Parser.exprStat .text.unlikely.Parser.exprStat)
    *(.text.Code.FuncState.fixLine .text.unlikely.Code.FuncState.fixLine)
    *(.text.Code.FuncState.codeBinI .text.unlikely.Code.FuncState.codeBinI)
    *(.text.Parser.checkReadonly .text.unlikely.Parser.checkReadonly)
    *(.text.Code.FuncState.codeABx .text.unlikely.Code.FuncState.codeABx)
    *(.text.Code.FuncState.codeArith .text.unlikely.Code.FuncState.codeArith)
    *(.text.Code.FuncState.setReturns .text.unlikely.Code.FuncState.setReturns)
    *(.text.hash_map.HashMapUnmanaged?Code.KKey?u32?Code.KKey.Context?80?.getIndex__anon_* .text.unlikely.hash_map.HashMapUnmanaged?Code.KKey?u32?Code.KKey.Context?80?.getIndex__anon_*)
    *(.text.Code.FuncState.setOneRet .text.unlikely.Code.FuncState.setOneRet)
    *(.text.Code.FuncState.discharge2anyreg .text.unlikely.Code.FuncState.discharge2anyreg)
    *(.text.Code.FuncState.getJumpControl .text.unlikely.Code.FuncState.getJumpControl)
    *(.text.Code.FuncState.fixJump .text.unlikely.Code.FuncState.fixJump)
    *(.text.fmt.parse_float.parse.tryParseDigits__anon_* .text.unlikely.fmt.parse_float.parse.tryParseDigits__anon_*)
    *(.text.Code.FuncState.needValue .text.unlikely.Code.FuncState.needValue)
    *(.text.lib.auxlib.Args.checkString .text.unlikely.lib.auxlib.Args.checkString)
    *(.text.Io.Writer.splatByteAll .text.unlikely.Io.Writer.splatByteAll)
    *(.text.gc.freeObject .text.unlikely.gc.freeObject)
    *(.text.gc.Raw.alignedAlloc__anon_* .text.unlikely.gc.Raw.alignedAlloc__anon_*)
    *(.text.lib.pattern.Matcher.maxExpand .text.unlikely.lib.pattern.Matcher.maxExpand)
    *(.text.lib.auxlib.metafield .text.unlikely.lib.auxlib.metafield)
    *(.text.vm.formatNumber .text.unlikely.vm.formatNumber)
    *(.text.Io.Writer.printIntAny__anon_* .text.unlikely.Io.Writer.printIntAny__anon_18528 .text.unlikely.Io.Writer.printIntAny__anon_4075)
    *(.text.lib.string.getEndPos .text.unlikely.lib.string.getEndPos)
    *(.text.lib.base.finishPcall .text.unlikely.lib.base.finishPcall)
  }
} INSERT BEFORE .text;
